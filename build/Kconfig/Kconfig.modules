## build/Kconfig/Kconfig.modules
```kconfig
menu "sniot_zephyr_template (/home/seatech/my-workspace/sniot_zephyr_template)"
osource "/home/seatech/my-workspace/sniot_zephyr_template/Kconfig"
config ZEPHYR_SNIOT_ZEPHYR_TEMPLATE_MODULE
	bool
	default y
endmenu
menu "cmsis_6 (/home/seatech/my-workspace/modules/hal/cmsis_6)"
osource "$(ZEPHYR_CMSIS_6_KCONFIG)"
config ZEPHYR_CMSIS_6_MODULE
	bool
	default y
endmenu
menu "hal_espressif (/home/seatech/my-workspace/modules/hal/espressif)"
osource "/home/seatech/my-workspace/modules/hal/espressif/zephyr/Kconfig"
config ZEPHYR_HAL_ESPRESSIF_MODULE
	bool
	default y
	select TAINT_BLOBS

config ZEPHYR_HAL_ESPRESSIF_MODULE_BLOBS
	bool
	default y
endmenu
menu "hal_nordic (/home/seatech/my-workspace/modules/hal/nordic)"
osource "$(ZEPHYR_HAL_NORDIC_KCONFIG)"
config ZEPHYR_HAL_NORDIC_MODULE
	bool
	default y

config ZEPHYR_HAL_NORDIC_MODULE_BLOBS
	bool
endmenu
config ZEPHYR_HAL_STM32_MODULE
	bool
	default y

config ZEPHYR_HAL_STM32_MODULE_BLOBS
	bool
config ZEPHYR_XTENSA_MODULE
	bool
	default y
```

## build/Kconfig/Kconfig.shield
```kconfig
osource "/home/seatech/my-workspace/sniot_zephyr_template/boards/shields/*/Kconfig.shield"
```

## build/Kconfig/Kconfig.shield.defconfig
```kconfig
osource "/home/seatech/my-workspace/sniot_zephyr_template/boards/shields/*/Kconfig.defconfig"
```

## build/Kconfig/boards/Kconfig.defconfig
```kconfig
# Load Zephyr board defconfig descriptions.
osource "/home/seatech/my-workspace/zephyr/boards/espressif/esp32_devkitc/Kconfig.defconfig"
```

## build/Kconfig/boards/Kconfig.esp32_devkitc
```kconfig
# Load board Kconfig descriptions.
osource "/home/seatech/my-workspace/zephyr/boards/espressif/esp32_devkitc/Kconfig.esp32_devkitc"
```

## build/Kconfig/boards/Kconfig.sysbuild
```kconfig
# Load Sysbuild board Kconfig descriptions.
osource "/home/seatech/my-workspace/zephyr/boards/espressif/esp32_devkitc/Kconfig.sysbuild"
```
